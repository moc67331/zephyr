## drivers/display/Kconfig.bcm2711
```kconfig
# Smartbond display controller configuration options
# SPDX-License-Identifier: Apache-2.0


config BCM2711
	bool "BCM2711 display driver"
	default y
	help
	  Enable BCM2711(for raspberry pi without pico) display controller.
```

## dts/bindings/display/brcm,bcm2711-display.yaml
```yaml
# Copyright (c) 2024
# SPDX-License-Identifier: Apache-2.0

description: Broadcom BCM2711 display controller

compatible: "brcm,bcm2711-display"

include: display-controller.yaml
```
